## CMakeLists.txt
```
cmake_minimum_required(VERSION 3.20.0)

find_package(Zephyr REQUIRED HINTS $ENV{ZEPHYR_BASE})

project(nrf91_coap_led_control)

target_sources(app PRIVATE
  src/main.c
)

if(CONFIG_LTE_LINK_CONTROL)
  target_sources(app PRIVATE src/modem.c)
endif()

target_include_directories(app PRIVATE
  include
)
```

## Kconfig
```
mainmenu "CoAP LED Control"

config COAP_SERVER_HOSTNAME
	string "CoAP server hostname or IP address"
	default "your-domain.com"
	help
	  Hostname or IP address of the CoAP server exposing the /led resource.

config COAP_SERVER_PORT
	int "CoAP server port"
	default 5683
	help
	  UDP port of the CoAP server.

config COAP_OBSERVE_REREGISTER_SECONDS
	int "Observe re-registration interval (seconds)"
	default 60
	help
	  How often the board re-sends the Observe registration.

source "Kconfig.zephyr"
```

## west.yml
```
manifest:
  remotes:
    - name: ncs
      url-base: https://github.com/nrfconnect

  projects:
    - name: nrf
      repo-path: sdk-nrf
      remote: ncs
      revision: v3.2.2
      import: true

  self:
    path: nrf91-coap-led-control
```

## prj.conf
```kconfig
CONFIG_COAP_SERVER_HOSTNAME="your-domain.com"

# Logging
CONFIG_LOG=y

# Board support
CONFIG_DK_LIBRARY=y

# Modem
CONFIG_NRF_MODEM_LIB=y
CONFIG_LTE_LINK_CONTROL=y
CONFIG_MODEM_INFO=y

# Networking
CONFIG_NETWORKING=y
CONFIG_NET_IPV4=y
CONFIG_NET_UDP=y
CONFIG_NET_SOCKETS=y
CONFIG_NET_SOCKETS_OFFLOAD=y
CONFIG_DNS_RESOLVER=y
CONFIG_POSIX_API=y

# Zephyr native CoAP
CONFIG_COAP=y

CONFIG_HEAP_MEM_POOL_SIZE=1032
CONFIG_MAIN_STACK_SIZE=2048
```

## boards/native_sim.conf
```kconfig
CONFIG_COAP_SERVER_HOSTNAME="192.0.2.2"

# Disable modem offload (native_sim use the host network stack directly)
CONFIG_NET_SOCKETS_OFFLOAD=n

# Native network driver
CONFIG_NET_DRIVERS=y
CONFIG_ETH_NATIVE_POSIX=y

# Disable nrf specific options
CONFIG_NRF_MODEM_LIB=n
CONFIG_LTE_LINK_CONTROL=n
CONFIG_MODEM_INFO=n
CONFIG_DK_LIBRARY=n

CONFIG_NET_CONFIG_SETTINGS=y
CONFIG_NET_CONFIG_MY_IPV4_ADDR="192.0.2.1"
CONFIG_NET_CONFIG_MY_IPV4_GW="192.0.1.1"
```

## src/main.c
```c
#include <zephyr/kernel.h>
#include <zephyr/net/coap.h>
#include <zephyr/net/socket.h>
#include <zephyr/logging/log.h>
#include <zephyr/random/random.h>

#ifdef CONFIG_DK_LIBRARY
#include <dk_buttons_and_leds.h>
#endif

#include "modem.h"

LOG_MODULE_REGISTER(coap_led, LOG_LEVEL_INF);

#define COAP_BUF_SIZE 256

static uint8_t coap_tx[COAP_BUF_SIZE];
static uint8_t coap_rx[COAP_BUF_SIZE];

static void led_apply(uint8_t state)
{
#ifdef CONFIG_DK_LIBRARY
  if (state) {
    dk_set_led_on(DK_LED2);
  } else {
    dk_set_led_off(DK_LED2);
  }
#endif
  LOG_INF("LED → %s", state ? "ON" : "OFF");
}

static int resolve_server(struct sockaddr *out)
{
  char            port_str[6];
  struct addrinfo hints = {
    .ai_family   = AF_INET,
    .ai_socktype = SOCK_DGRAM,
    .ai_protocol = IPPROTO_UDP,
  };
  struct addrinfo *res = NULL;

  snprintk(port_str, sizeof(port_str), "%d", CONFIG_COAP_SERVER_PORT);

  int ret = getaddrinfo(CONFIG_COAP_SERVER_HOSTNAME, port_str, &hints, &res);
  if (ret != 0) {
    LOG_ERR("getaddrinfo(%s): %d", CONFIG_COAP_SERVER_HOSTNAME, ret);
    return -ENOENT;
  }

  memcpy(out, res->ai_addr, res->ai_addrlen);
  freeaddrinfo(res);

  char addr_str[NET_IPV4_ADDR_LEN];
  net_addr_ntop(AF_INET, &net_sin(out)->sin_addr, addr_str, sizeof(addr_str));
  LOG_INF("Resolved %s: %s:%d", CONFIG_COAP_SERVER_HOSTNAME, addr_str,
          CONFIG_COAP_SERVER_PORT);

  return 0;
}

static int send_observe_request(int sock, const struct sockaddr *server,
                                uint8_t *token, uint8_t tkl)
{
  struct coap_packet req;
  uint16_t           msg_id;
  uint8_t            obs;
  int                ret;

  msg_id = sys_rand32_get() & 0xFFFF;
  obs    = 0;

  ret = coap_packet_init(&req, coap_tx, sizeof(coap_tx), COAP_VERSION_1,
                         COAP_TYPE_CON, tkl, token, COAP_METHOD_GET, msg_id);
  if (ret < 0) {
    return ret;
  }

  ret = coap_packet_append_option(&req, COAP_OPTION_OBSERVE, &obs, sizeof(obs));
  if (ret < 0) {
    return ret;
  }

  ret =
    coap_packet_append_option(&req, COAP_OPTION_URI_PATH, "led", strlen("led"));
  if (ret < 0) {
    return ret;
  }

  ret = sendto(sock, req.data, req.offset, 0, server, sizeof(struct sockaddr));
  if (ret < 0) {
    LOG_ERR("sendto: %d", errno);
    return -errno;
  }

  LOG_INF("Observe registration sent (id=0x%04x)", msg_id);
  return 0;
}

static int send_ack(int sock, const struct sockaddr *server, uint16_t msg_id,
                    uint8_t *token, uint8_t tkl)
{
  struct coap_packet ack;
  int                ret;

  ret = coap_packet_init(&ack, coap_tx, sizeof(coap_tx), COAP_VERSION_1,
                         COAP_TYPE_ACK, tkl, token, COAP_CODE_EMPTY, msg_id);
  if (ret < 0) {
    return ret;
  }

  return sendto(sock, ack.data, ack.offset, 0, server, sizeof(struct sockaddr));
}

/*
 * Re-send the Observe registration if the deadline has passed.
 * Updates *last_reg_ms on success.
 * Returns 0 on success, negative on send failure.
 */
static int maybe_reregister(int sock, const struct sockaddr *server,
                            uint8_t *token, uint8_t tkl, int64_t *last_reg_ms,
                            int64_t rereg_ms)
{
  int64_t elapsed;

  elapsed = k_uptime_get() - *last_reg_ms;
  if (elapsed < rereg_ms) {
    return 0;
  }

  LOG_INF("Re-registering observer...");
  int ret = send_observe_request(sock, server, token, tkl);
  if (ret < 0) {
    return ret;
  }

  *last_reg_ms = k_uptime_get();
  return 0;
}

static int receive_coap_packet(int sock, struct coap_packet *pkt,
                               struct coap_option *options, uint8_t opt_count,
                               struct sockaddr *src, socklen_t *src_len)
{
  int received;
  int ret;

  received = recvfrom(sock, coap_rx, sizeof(coap_rx), 0, src, src_len);
  if (received < 0) {
    LOG_ERR("recvfrom: %d", errno);
    return -errno;
  }

  ret = coap_packet_parse(pkt, coap_rx, received, options, opt_count);
  if (ret < 0) {
    LOG_WRN("Bad CoAP packet: %d", ret);
    return ret;
  }

  return received;
}

static int handle_packet(int sock, const struct sockaddr *src,
                         const struct coap_packet *pkt,
                         const uint8_t *session_token, uint8_t session_tkl)
{
  uint16_t       id;
  uint8_t        code;
  uint8_t        type;
  uint8_t        rx_tkl;
  const uint8_t *payload;
  uint16_t       payload_len;
  uint8_t        rx_token[COAP_TOKEN_MAX_LEN];

  rx_tkl = coap_header_get_token(pkt, rx_token);
  if (rx_tkl != session_tkl ||
      memcmp(rx_token, session_token, session_tkl) != 0) {
    LOG_WRN("Unknown token, ignoring");
    return -EBADMSG;
  }

  code = coap_header_get_code(pkt);
  type = coap_header_get_type(pkt);
  id   = coap_header_get_id(pkt);

  if (type == COAP_TYPE_CON) {
    send_ack(sock, src, id, rx_token, rx_tkl);
  }

  if (code == COAP_RESPONSE_CODE_CONTENT) {
    payload = coap_packet_get_payload(pkt, &payload_len);
    if (payload && payload_len >= 1) {
      led_apply(payload[0] == '1' ? 1 : 0);
    }
  } else {
    LOG_WRN("Unexpected code 0x%02x", code);
  }

  return 0;
}

static void observe_loop(int sock, const struct sockaddr *server)
{
  int                ret;
  struct pollfd      pfd;
  struct sockaddr    src;
  struct coap_packet pkt;
  uint32_t           rnd;
  int64_t            rereg_ms;
  uint8_t            token[4];
  int64_t            remaining;
  struct coap_option options[8];
  int                timeout_ms;
  int64_t            last_reg_ms;

  rnd = sys_rand32_get();
  memcpy(token, &rnd, sizeof(token));

  if (send_observe_request(sock, server, token, sizeof(token)) < 0) {
    return;
  }

  last_reg_ms = k_uptime_get();
  rereg_ms    = CONFIG_COAP_OBSERVE_REREGISTER_SECONDS * 1000;

  pfd.fd     = sock;
  pfd.events = POLLIN;

  while (1) {
    if (maybe_reregister(sock, server, token, sizeof(token), &last_reg_ms,
                         rereg_ms) < 0) {
      return;
    }

    remaining  = rereg_ms - (k_uptime_get() - last_reg_ms);
    timeout_ms = (int)(remaining > INT32_MAX ? INT32_MAX : remaining);

    ret = poll(&pfd, 1, timeout_ms);
    if (ret < 0) {
      LOG_ERR("poll: %d", errno);
      return;
    }
    if (ret == 0) {
      continue;
    }

    ret = receive_coap_packet(sock, &pkt, options, ARRAY_SIZE(options), &src,
                              &(socklen_t){sizeof(src)});
    if (ret < 0) {
      return;
    }

    handle_packet(sock, &src, &pkt, token, sizeof(token));
  }
}

int main(void)
{
  int             err;
  int             sock;
  struct sockaddr server;

#ifdef CONFIG_DK_LIBRARY
  if (dk_leds_init() != 0) {
    LOG_ERR("Failed to initialize LEDs");
    return -ENODEV;
  }
#endif

#ifdef CONFIG_LTE_LINK_CONTROL
  err = modem_configure();
  if (err) {
    LOG_ERR("Modem configuration failed: %d", err);
    return err;
  }
#endif

  if (resolve_server(&server) < 0) {
    LOG_ERR("Failed to resolve server address");
    return -1;
  }

  while (1) {
    sock = socket(AF_INET, SOCK_DGRAM, IPPROTO_UDP);
    if (sock < 0) {
      LOG_ERR("Failed to create socket: %d", errno);
      return -1;
    }

    observe_loop(sock, &server);

    close(sock);
    LOG_WRN("Reconnecting in 5s...");
    k_sleep(K_SECONDS(5));
  }

  return 0;
}
```

## include/modem.h
```c
#ifndef MODEM_H
#define MODEM_H

int modem_configure(void);

#endif /* MODEM_H */
```

## src/modem.c
```c
#include <modem/lte_lc.h>
#include <modem/nrf_modem_lib.h>
#include <modem/modem_info.h>
#include <zephyr/logging/log.h>

LOG_MODULE_REGISTER(modem);

static K_SEM_DEFINE(lte_connected_sem, 0, 1);

static void lte_handler(const struct lte_lc_evt *const evt)
{
  switch (evt->type) {
  case LTE_LC_EVT_NW_REG_STATUS:
    if (evt->nw_reg_status != LTE_LC_NW_REG_REGISTERED_HOME &&
        evt->nw_reg_status != LTE_LC_NW_REG_REGISTERED_ROAMING) {
      break;
    }
    LOG_INF("LTE registered: %s",
            evt->nw_reg_status == LTE_LC_NW_REG_REGISTERED_HOME ? "home network"
                                                                : "roaming");
    k_sem_give(&lte_connected_sem);
    break;

  case LTE_LC_EVT_RRC_UPDATE:
    LOG_INF("RRC mode: %s",
            evt->rrc_mode == LTE_LC_RRC_MODE_CONNECTED ? "connected" : "idle");
    break;
  default:
    break;
  }
}

int modem_configure(void)
{
  int err;

  LOG_INF("Initializing modem library");
  err = nrf_modem_lib_init();
  if (err) {
    LOG_ERR("Failed to initialize modem library: %d", err);
    return err;
  }

  LOG_INF("Connecting to LTE network");
  err = lte_lc_connect_async(lte_handler);
  if (err) {
    LOG_ERR("lte_lc_connect_async failed: %d", err);
    return err;
  }

  k_sem_take(&lte_connected_sem, K_FOREVER);
  LOG_INF("Connected to LTE network");

  return 0;
}
```
